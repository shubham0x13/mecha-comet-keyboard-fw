## Kconfig
```kconfig
# Copyright (c) 2026 Mecha Systems
# SPDX-License-Identifier: BSD-3-Clause

rsource "drivers/Kconfig"

config MECHA_KEYBOARD_LAYER_LEDS
    bool "Show two layers on the layer LEDs"
    default y
    depends on $(dt_nodelabel_enabled,layer1_led) && $(dt_nodelabel_enabled,layer2_led)
    select LED
    help
      Layer LED 1 and layer LED 2 are on while their layer is active.

if MECHA_KEYBOARD_LAYER_LEDS

config MECHA_KEYBOARD_LAYER_LED1_LAYER
    int "Layer shown on layer LED 1"
    default 1
    range 1 31
    help
      Layer ID, as used in keymap bindings such as &mo 1.

config MECHA_KEYBOARD_LAYER_LED2_LAYER
    int "Layer shown on layer LED 2"
    default 2
    range 1 31
    help
      Layer ID, as used in keymap bindings such as &mo 1.

endif # MECHA_KEYBOARD_LAYER_LEDS

config MECHA_KEYBOARD_ROM_BOOTLOADER
    bool "Make the bootloader key reboot into the boot ROM"
    default y
    depends on SOC_SERIES_MCXC && REBOOT
    help
      Without this, the bootloader key only resets the board.
```

## boards/mecha/mecha_comet_keyboard/Kconfig.mecha_comet_keyboard
```kconfig
# Copyright (c) 2026 Mecha Systems
# SPDX-License-Identifier: BSD-3-Clause

config BOARD_MECHA_COMET_KEYBOARD
    select SOC_MCXC243
    select SOC_PART_NUMBER_MCXC243VFT
    select ZMK_BOARD_COMPAT
```

## boards/mecha/mecha_comet_keyboard/board.yml
```yaml
board:
  name: mecha_comet_keyboard
  full_name: Mecha Comet Keyboard Extension
  vendor: mecha
  socs:
    - name: mcxc243
      variants:
        - name: zmk
```

## drivers/Kconfig
```kconfig
# Copyright (c) 2026 Mecha Systems
# SPDX-License-Identifier: BSD-3-Clause

rsource "led_strip/Kconfig"
```

## drivers/led_strip/Kconfig
```kconfig
# Copyright (c) 2026 Mecha Systems
# SPDX-License-Identifier: BSD-3-Clause

config WS2812_STRIP_GPIO_MCXC
    bool "WS2812 LED strip GPIO bit-bang driver for NXP MCX C"
    default y
    depends on DT_HAS_WORLDSEMI_WS2812_GPIO_ENABLED
    depends on SOC_SERIES_MCXC
    depends on LED_STRIP
    depends on !WS2812_STRIP_GPIO
    help
      Drives a WS2812 (or compatible) LED strip by bit-banging one GPIO pin
      from inline assembly that runs from RAM with interrupts locked. The
      pulse timing assumes a 48 MHz core clock and is set with the delay-*
      properties of the worldsemi,ws2812-gpio devicetree node.

DT_CHOSEN_WS2812_WAIT_FOR_I2C := mecha,ws2812-wait-for-i2c

config WS2812_STRIP_GPIO_MCXC_WAIT_FOR_I2C
    bool "Send LED frames only while an I2C bus is idle"
    default y
    depends on WS2812_STRIP_GPIO_MCXC
    depends on I2C
    depends on $(dt_chosen_enabled,$(DT_CHOSEN_WS2812_WAIT_FOR_I2C))
    help
      A frame is sent with interrupts locked for about 0.3 ms. An interrupt-driven
      I2C transfer that is running during that time can return wrong data. With
      this option the driver waits, for at most 2 ms, until the I2C module named
      by the mecha,ws2812-wait-for-i2c chosen property has no transfer running.
```
